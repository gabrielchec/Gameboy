#include "system.h"



void lcd_set_point_v(_Bool value, uint8_t x, uint8_t y){
	uint8_t actual = display[ x + (y >> 3) * LCD_COL_SIZE];

	if(value)
		display[ x + (y >> 3) * LCD_COL_SIZE] = actual | 1 << (0x07 & y);
	else
		display[ x + (y >> 3) * LCD_COL_SIZE] = ~((~actual) | 1 << (0x07 & y))  ;
}


void lcd_set_point_p(_Bool value, const Point * point){
	uint8_t actual = display[ point->x + (point->y >> 3) * LCD_COL_SIZE];

	if(value)
		display[ point->x + (point->y >> 3) * LCD_COL_SIZE] = actual | 1 << (0x07 & point->y);
	else
		display[ point->x + (point->y >> 3) * LCD_COL_SIZE] = ~((~actual) | 1 << (0x07 & point->y))  ;
}


void lcd_write_line(uint8_t* data, uint8_t row, uint8_t col){
	if( row < 0){
		data -= row;
		row = 0;
	}

	uint8_t* buffer = &display[row * LCD_COL_SIZE + col];
	while(*(data) && (buffer < &display[(row+1) * LCD_COL_SIZE])){
		for(int i = 0 ; i < 5; i++){
			*buffer++ = font_ASCII[(int)*data - (int)' '][i];
			if(!*(data)) break;
		}
		data++;
		*buffer++ = 0;
	}
}


void lcd_write_long_text(uint8_t* data, uint8_t row, uint8_t col){
	uint8_t* buffer = &display[row * LCD_COL_SIZE + col];
	while(*(data) && (buffer < &display[LCD_SIZE])){
		for(int i = 0; i < 5; i++){
			*buffer++ = font_ASCII[(int)*data - (int)' '][i];
		}
		data++;
		*buffer++ = 0;
	}
}

void lcd_reset(){
	HAL_GPIO_WritePin(LCD_RST_GPIO_Port, LCD_RST_Pin, GPIO_PIN_RESET);
	HAL_GPIO_WritePin(LCD_RST_GPIO_Port, LCD_RST_Pin, GPIO_PIN_SET);
}

void lcd_cmd(uint8_t cmd){
	HAL_GPIO_WritePin(LCD_CE_GPIO_Port, LCD_CE_Pin | LCD_DC_Pin , GPIO_PIN_RESET);
	HAL_SPI_Transmit(&hspi2, &cmd, 1, HAL_MAX_DELAY);
	HAL_GPIO_WritePin(LCD_CE_GPIO_Port, LCD_CE_Pin | LCD_DC_Pin, GPIO_PIN_SET);
}


void lcd_data(const uint8_t* data, int size){
	HAL_GPIO_WritePin(LCD_DC_GPIO_Port, LCD_DC_Pin, GPIO_PIN_SET);
	HAL_GPIO_WritePin(LCD_CE_GPIO_Port, LCD_CE_Pin, GPIO_PIN_RESET);
	HAL_SPI_Transmit(&hspi2, (uint8_t*)data, size, HAL_MAX_DELAY);
	HAL_GPIO_WritePin(LCD_CE_GPIO_Port, LCD_CE_Pin, GPIO_PIN_SET);

}

void system_init(){
	lcd_reset();
	lcd_cmd(0x21);
	lcd_cmd(0x14);
	lcd_cmd(0x80 | 0x3f);
	lcd_cmd(0x20);
	lcd_cmd(0x0c);
}

uint8_t display[LCD_SIZE] = {
	0x00, 0x00, 0x00, 0x00, 0x00, 0x00, 0x00, 0x00, 0x00, 0x00, 0x00, 0x00, 0x00, 0x00, 0x00, 0x00,
	0x00, 0x00, 0x00, 0x00, 0x00, 0x00, 0x00, 0x00, 0x00, 0x00, 0x00, 0x00, 0x00, 0x00, 0x00, 0x00,
	0x00, 0x00, 0x00, 0x00, 0x00, 0x00, 0x00, 0x00, 0x00, 0x00, 0x00, 0x00, 0x00, 0x00, 0x00, 0x00,
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	0x00, 0x00, 0x00, 0x00, 0x00, 0x00, 0x00, 0x00};
